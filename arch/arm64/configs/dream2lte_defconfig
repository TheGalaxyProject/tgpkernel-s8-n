## arch/arm64/configs/dream2lte_defconfig
```kconfig
#
# Modifications for Samsung Galaxy S8+ (dream2lte)
#
CONFIG_CAMERA_CIS_3M3_OBJ=y
CONFIG_CAMERA_DREAM2=y
CONFIG_POC_DREAM2=y
CONFIG_SENSORS_HRM_ADPD143=y
CONFIG_TOUCHSCREEN_SEC_TS=y
CONFIG_OIS_USE_RUMBA_S4=y
CONFIG_MOTOR_DRV2624=y
```

## arch/arm64/configs/dreamlte_defconfig
```kconfig
#
# Modifications for Samsung Galaxy S8 (dreamlte)
#
CONFIG_CAMERA_DREAM=y
CONFIG_POC_DREAM=y
CONFIG_TOUCHSCREEN_SEC_TS=y
CONFIG_OIS_USE_RUMBA_S4=y
CONFIG_MOTOR_DRV2624=y
```

## arch/arm64/configs/greatlte_defconfig
```kconfig
#
# Modifications for Samsung Galaxy Note 8 (greatlte)
#
CONFIG_TOUCHSCREEN_SEC_TS_Y661=y
CONFIG_INPUT_WACOM=y
CONFIG_EPEN_WACOM_W9018=y
CONFIG_CAMERA_CIS_3M3_OBJ=y
CONFIG_CAMERA_GREAT=y
CONFIG_OIS_USE_RUMBA_S6=y
CONFIG_PANEL_POC_2_0=y
CONFIG_SEC_ABC=y
```
